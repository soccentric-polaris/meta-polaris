## conf/layer.conf
```bitbake
BBPATH .= ":${LAYERDIR}"

BBFILES += " \
    ${LAYERDIR}/recipes-*/*/*.bb \
    ${LAYERDIR}/recipes-*/*/*.bbappend \
"

BBFILE_COLLECTIONS += "meta-polaris"
BBFILE_PATTERN_meta-polaris = "^${LAYERDIR}/"
BBFILE_PRIORITY_meta-polaris = "10"

LAYERDEPENDS_meta-polaris = "core meta-rz-bsp"
LAYERSERIES_COMPAT_meta-polaris = "scarthgap"
```
